/**
  ******************************************************************************
  * File Name          : main.c
  * Description        : Main program body
  ******************************************************************************
  *
  * COPYRIGHT(c) 2016 STMicroelectronics
  *
  * Redistribution and use in source and binary forms, with or without modification,
  * are permitted provided that the following conditions are met:
  *   1. Redistributions of source code must retain the above copyright notice,
  *      this list of conditions and the following disclaimer.
  *   2. Redistributions in binary form must reproduce the above copyright notice,
  *      this list of conditions and the following disclaimer in the documentation
  *      and/or other materials provided with the distribution.
  *   3. Neither the name of STMicroelectronics nor the names of its contributors
  *      may be used to endorse or promote products derived from this software
  *      without specific prior written permission.
  *
  * THIS SOFTWARE IS PROVIDED BY THE COPYRIGHT HOLDERS AND CONTRIBUTORS "AS IS"
  * AND ANY EXPRESS OR IMPLIED WARRANTIES, INCLUDING, BUT NOT LIMITED TO, THE
  * IMPLIED WARRANTIES OF MERCHANTABILITY AND FITNESS FOR A PARTICULAR PURPOSE ARE
  * DISCLAIMED. IN NO EVENT SHALL THE COPYRIGHT HOLDER OR CONTRIBUTORS BE LIABLE
  * FOR ANY DIRECT, INDIRECT, INCIDENTAL, SPECIAL, EXEMPLARY, OR CONSEQUENTIAL
  * DAMAGES (INCLUDING, BUT NOT LIMITED TO, PROCUREMENT OF SUBSTITUTE GOODS OR
  * SERVICES; LOSS OF USE, DATA, OR PROFITS; OR BUSINESS INTERRUPTION) HOWEVER
  * CAUSED AND ON ANY THEORY OF LIABILITY, WHETHER IN CONTRACT, STRICT LIABILITY,
  * OR TORT (INCLUDING NEGLIGENCE OR OTHERWISE) ARISING IN ANY WAY OUT OF THE USE
  * OF THIS SOFTWARE, EVEN IF ADVISED OF THE POSSIBILITY OF SUCH DAMAGE.
  *
  ******************************************************************************
  */
/* Includes ------------------------------------------------------------------*/
#include "stm32f0xx_hal.h"

/* USER CODE BEGIN Includes */

#include <string.h>

/* USER CODE END Includes */

/* Private variables ---------------------------------------------------------*/
UART_HandleTypeDef huart2;

/* USER CODE BEGIN PV */
/* Private variables ---------------------------------------------------------*/

/*
  Commands and Color specification codes (Epson S1D15G00)
  Author: Nicolas Nascimento (nicolas.nascimento@acad.pucrs.br)
*/

#define NOP   			0x00   		// NOP
#define SWRESET  		0x01      // Software reset
#define BSTROFF  		0x02      // Booster Voltage Off
#define BSTRON  		0x03      // Booster Voltage On
#define RDDIDIF  		0x04      // Read display identification
#define RDDST  			0x09      // Read display status
#define SLEEPIN   	0x10      // Sleep in
#define SLEEPOUT  	0x11      // Sleep out
#define PTLON   		0x12      // Partial display mode
#define NORON   		0x13      // Display normal mode
#define INVOFF  		0x20      // Inversion off
#define INVON 			0x21      // Inversion on
#define DALO   			0x22      // All pixel off
#define DAL   			0x23      // All pixel on
#define SETCON   		0x25      // Write contrast
#define DISPOFF  		0x28      // Display off
#define DISPON   		0x29      // Display on
#define CASET  			0x2A      // Column address set
#define PASET  			0x2B      // Page address set
#define RAMWR 			0x2C      // Memory write
#define RGBSET   		0x2D      // Color set
#define PTLAR  			0x30      // Partial area
#define VSCRDEF  		0x33      // Vertical scrolling definition
#define TEOFF  			0x34      // Test mode
#define TEON   			0x35      // Test mode
#define MADCTL 			0x36      // Memory access control
#define SEP  				0x37      // Vertical scrolling start address
#define IDMOFF  		0x38      // Idle mode off
#define IDMON  			0x39      // Idle mode on
#define COLMOD   		0x3A      // Interface pixel format
#define SETVOP   		0xB0      // Set vop
#define BRS 				0xB4      // Bottom row swap
#define TRS 				0xB6      // Top row swap
#define DISCTR     	0xB9      // Display control
#define DOR     		0xBA      // Data order
#define TCDFE     	0xBD      // Enable/Disable DF Temperature compensation
#define TCVOPE     	0xBF      // Enable/Disable VOP Temp. comp
#define EC     			0xC0      // Internal or external oscilator
#define SETMUL     	0xC2      // Set multiplication factor
#define TCVOPAB     0xC3      // Set TCVOP Slopes A and B
#define TCVOPCD     0xC4      // Set TCVOP Slopes C and D
#define TCDF     		0xC5      // Set divider frequency
#define DF8COLOR    0xC6      // Set divider frequency 8-color mode
#define SETBS     	0xC7      // Set bias system
#define RDTEMP     	0xC8      // Temperature read back
#define NLI 				0xC9			// N-line inversion
#define RDID1 			0xDA			// Read ID1
#define RDID2 			0xDB			// Read ID2
#define RDID3 			0xDC			// Read ID3

// Backlight
#define BKLGHT_LCD_ON   1
#define BKLGHT_LCD_OFF  2

// Booleans
#define NOFILL          0
#define FILL            1

// 12-bit color definitions
#define WHITE           0xFFF
#define BLACK           0x000
#define RED             0xF00
#define GREEN           0x0F0
#define BLUE            0x00F
#define CYAN            0x0FF
#define MAGENTA         0xF0F
#define YELLOW          0xFF0
#define BROWN           0xB22
#define ORANGE          0xFA0
#define PINK            0xF6A

// Font sizes
#define SMALL           0
#define MEDIUM          1
#define LARGE           2

// Bit definition
#define BIT(N) (1<<N)

// Hardware definitions
#define SPI_SR_TXEMPTY
#define LCD_RESET_LOW   (GPIOA->BRR = BIT(0))
#define LCD_RESET_HIGH  (GPIOA->BSRR = BIT(0))


const unsigned char FONT6x8[97][8] = {
0x06,0x08,0x08,0x00,0x00,0x00,0x00,0x00,            // Columns, rows, num_bytes_per_char
0x00,0x00,0x00,0x00,0x00,0x00,0x00,0x00,            // space  0x20
0x20,0x20,0x20,0x20,0x20,0x00,0x20,0x00,            // !
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0x70,0xD8,0xD8,0x70,0x00,0x00,0x00,0x00};           // DEL

const unsigned char FONT8x8[97][8] = {
0x08,0x08,0x08,0x00,0x00,0x00,0x00,0x00,  // columns, rows, num_bytes_per_char
0x00,0x00,0x00,0x00,0x00,0x00,0x00,0x00,  // space
0x30,0x78,0x78,0x30,0x30,0x00,0x30,0x00,  // !
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0x1C,0x36,0x36,0x1C,0x00,0x00,0x00,0x00   // DEL
};

const unsigned char FONT8x16[97][16] = {
0x08,0x10,0x10,0x00,0x00,0x00,0x00,0x00,0x00,0x00,0x00,0x00,0x00,0x00,0x00,0x00,
0x00,0x00,0x00,0x00,0x00,0x00,0x00,0x00,0x00,0x00,0x00,0x00,0x00,0x00,0x00,0x00,
0x00,0x00,0x18,0x3C,0x3C,0x3C,0x18,0x18,0x18,0x00,0x18,0x18,0x00,0x00,0x00,0x00,
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0x00,0x70,0xD8,0xD8,0x70,0x00,0x00,0x00,0x00,0x00,0x00,0x00,0x00,0x00,0x00,0x00
};

/* USER CODE END PV */

/* Private function prototypes -----------------------------------------------*/
void SystemClock_Config(void);
static void MX_GPIO_Init(void);
static void MX_USART2_UART_Init(void);

/* USER CODE BEGIN PFP */
/* Private function prototypes -----------------------------------------------*/


void uart_put_str(char* string) {
	char string_to_s[strlen(string) + 1];
	strcpy(string_to_s, string);
	strcat(string_to_s, "\n");
	HAL_UART_Transmit(&huart2, (uint8_t*)string_to_s, strlen(string_to_s), 1000);
	HAL_Delay(50);
}

void write_spi(uint32_t data) {
	
	int i;
	uint32_t mask = 0x100;
  GPIOB->BRR = BIT(0); // CS = 0
	GPIOA->BSRR = BIT(5); // LED = 1
	__NOP();
	__NOP();
	__NOP();
	__NOP();
	__NOP();
	
  GPIOA->BRR = BIT(4); // SCLK = 0
	do {
    if(data & mask) GPIOA->BSRR = BIT(1);
		else GPIOA->BRR = BIT(1);
		
		__NOP();
		__NOP();
		__NOP();
		__NOP();
		__NOP();
    GPIOA->BSRR = BIT(4); // SCLK = 1
		
    __NOP();
		__NOP();
		__NOP();
		__NOP();
		__NOP();
    GPIOA->BRR = BIT(4); // SCLK = 0
		
    mask >>= 1;
	}while(mask != 0);
	
	GPIOB->BSRR = BIT(0); // CS = 1
	GPIOA->BRR = BIT(5); // LED = 0
	
	__NOP();
	__NOP();
	__NOP();
	__NOP();
	__NOP();
	__NOP();
}

void write_spi_command(uint32_t command) {
  // clear bit 8 - indicates a "command"
  command = (command & ~0x0100);
	write_spi(command);
}

void write_spi_data(uint32_t data) {
  // set bit 8 - indicating a "command"
  data = (data | 0x0100);
	write_spi(data);
}

void backlight(unsigned char state) {
  // The shield was build in a way the backlight cannot be mannualy controlled.
  // So this does nothing
}

void init_lcd(void) {
	
  // Hardware reset
  LCD_RESET_LOW;
  HAL_Delay(10);
  LCD_RESET_HIGH;
  HAL_Delay(10);
	
	uart_put_str("init_lcd");
	
  // Display control
  write_spi_command(SLEEPOUT);
  
	write_spi_command(INVON);
	
	write_spi_command(COLMOD);
	write_spi_data(0x03);
	
	write_spi_command(MADCTL);
	write_spi_data(0xC8);
	
	write_spi_command(SETCON);
	write_spi_data(0x30);


	HAL_Delay(10);
	
	write_spi_command(DISPON);
}


void lcd_write_130_130_bmp(void) {
  // This function should get a picture defined in bmp.h and show it
  // Because we won't be dealing with images, this does nothing

}

void lcd_clear_screen(void) {
  long i;
	
	uart_put_str("lcd_clear_screen");
	
  // Row address set  (command 0x2B)
  write_spi_command(PASET);
  write_spi_data(0);
  write_spi_data(131);
  // loop counter
  // Column address set  (command 0x2A)
  write_spi_command(CASET);
  write_spi_data(0);
  write_spi_data(131);
  // set the display memory to BLACK
  write_spi_command(RAMWR);
  for(i = 0; i < ((131 * 131) / 2); i++) {
    write_spi_data((BLACK >> 4) & 0xFF);
    write_spi_data(((BLACK & 0xF) << 4) | ((BLACK >> 8) & 0xF));
    write_spi_data(BLACK & 0xFF);
  }
}

void lcd_set_pixel(int x, int y, int color) {
	
  // Row address set  (command 0x2B)
  write_spi_command(PASET);
  write_spi_data(x);
  write_spi_data(x);
  // Column address set  (command 0x2A)
  write_spi_command(CASET);
  write_spi_data(y);
  write_spi_data(y);
  // Now illuminate the pixel (2nd pixel will be ignored)
  write_spi_command(RAMWR);
  write_spi_data((color >> 4) & 0xFF);
  write_spi_data(((color & 0xF) << 4) | ((color >> 8) & 0xF));
  write_spi_data(color & 0xFF);
}

void lcd_set_line(int x0, int y0, int x1, int y1, int color) {
  int dy = y1 - y0;
  int dx = x1 - x0;
  int stepx, stepy;

  if(dy < 0){
    dy=-dy;
    stepy=-1;
  }else{
    stepy=1;
  }
  if( dx < 0 ){
    dx=-dx;
    stepx=-1;
  }else{
    stepx=1;
  }
  dy <<= 1; // dy is now 2*dy
  dx <<= 1; // dx is now 2*dx

  lcd_set_pixel(x0, y0, color);
  if (dx > dy) {
    int fraction = dy - (dx >> 1);// same as 2*dy - dx
    while (x0 != x1) {
      if (fraction >= 0) {
        y0 += stepy;
        fraction -= dx; // same as fraction -= 2*dx
      }
      x0 += stepx;
      fraction += dy; // same as fraction -= 2*dy
      lcd_set_pixel(x0, y0, color);
    }
  }else{
    int fraction = dx - (dy >> 1);
    while (y0 != y1) {
      if (fraction >= 0) {
        x0 += stepx;
        fraction -= dy;
      }
      y0 += stepy;
      fraction += dx;
      lcd_set_pixel(x0, y0, color);
    }
  }

}

void lcd_set_rect(int x0, int y0, int x1, int y1, unsigned char fill, int color) {
  int xmin, xmax, ymin, ymax;
  int i;
  // check if the rectangle is to be filled
  if (fill == FILL) {
    // best way to create a filled rectangle is to define a drawing box
    // and loop two pixels at a time
    // calculate the min and max for x and y directions
    xmin = (x0 <= x1) ? x0 : x1;
    xmax = (x0 > x1) ? x0 : x1;
    ymin = (y0 <= y1) ? y0 : y1;
    ymax = (y0 > y1) ? y0 : y1;
    // specify the controller drawing box according to those limits
    // Row address set (command 0x2B)
    write_spi_command(PASET);
    write_spi_data(xmin);
    write_spi_data(xmax);
    // Column address set  (command 0x2A)
    write_spi_command(CASET);
    write_spi_data(ymin);
    write_spi_data(ymax);
    // WRITE MEMORY
    write_spi_command(RAMWR);
    // loop on total number of pixels / 2
    for (i = 0; i < ((((xmax - xmin + 1) * (ymax - ymin + 1)) / 2) + 130); i++) {
      // use the color value to output three data bytes covering two pixels
      write_spi_data((color >> 4) & 0xFF);
      write_spi_data(((color & 0xF) << 4) | ((color >> 8) & 0xF));
      write_spi_data(color & 0xFF);
    }
  } else {
    // best way to draw un unfilled rectangle is to draw four lines
    lcd_set_line(x0, y0, x1, y0, color);
    lcd_set_line(x0, y1, x1, y1, color);
    lcd_set_line(x0, y0, x0, y1, color);
    lcd_set_line(x1, y0, x1, y1, color);
  }
}

void lcd_set_circle(int x0, int y0, int radius, int color) {
  int f = 1 - radius;
  int ddF_x = 0;
  int ddF_y = -2 * radius;
  int x = 0;
  int y = radius;
  lcd_set_pixel(x0, y0 + radius, color);
  lcd_set_pixel(x0, y0 - radius, color);
  lcd_set_pixel(x0 + radius, y0, color);
  lcd_set_pixel(x0 - radius, y0, color);

  while(x < y) {
    if(f >= 0) {
      y--;
      ddF_y += 2;
      f += ddF_y;
    }
    x++;
    ddF_x += 2;
    f += ddF_x + 1;
    lcd_set_pixel(x0 + x, y0 + y, color);
    lcd_set_pixel(x0 - x, y0 + y, color);
    lcd_set_pixel(x0 + x, y0 - y, color);
    lcd_set_pixel(x0 - x, y0 - y, color);
    lcd_set_pixel(x0 + y, y0 + x, color);
    lcd_set_pixel(x0 - y, y0 + x, color);
    lcd_set_pixel(x0 + y, y0 - x, color);
    lcd_set_pixel(x0 - y, y0 - x, color);
  }
}

void lcd_put_char(char c, int x, int y, int size, int fcolor, int bcolor) {
  /*extern const unsigned char FONT6x8[97][8];
  extern const unsigned char FONT8x8[97][8];
  extern const unsigned char FONT8x16[97][16];*/
  int i,j;
  unsigned int nCols;
  unsigned int nRows;
  unsigned int nBytes;
  unsigned char PixelRow;
  unsigned char Mask;

  unsigned int Word0;
  unsigned int Word1;
  unsigned char *pFont;
  unsigned char *pChar;
  unsigned char *FontTable[] = {(unsigned char *)FONT6x8, (unsigned char *)FONT8x8, (unsigned char *)FONT8x16};

  // get pointer to the beginning of the selected font table
  pFont = (unsigned char *)FontTable[size];
  // get the nColumns, nRows and nBytes
  nCols = *pFont;
  nRows = *(pFont + 1);
  nBytes = *(pFont + 2);
  // get pointer to the last byte of the desired character
  pChar = pFont + (nBytes * (c - 0x1F)) + nBytes - 1;
  // Row address set  (command 0x2B)
  write_spi_command(PASET);
  write_spi_data(x);
  write_spi_data(x + nRows - 1);
  // Column address set  (command 0x2A)
  write_spi_command(CASET);
  write_spi_data(y);
  write_spi_data(y + nCols - 1);

  // Write Memory
  write_spi_command(RAMWR);

  // loop on each row, working backwards from the bottom to the top for (i = nRows - 1; i >= 0; i--) {
  Mask = 0x80;
  for (i = nRows - 1; i >= 0; i--) {
    // copy pixel row from font table and then decrement row
    PixelRow = *pChar--;
    // loop on each pixel in the row (left to right)
    // Note: we do two pixels each loop
    Mask = 0x80;
    for (j = 0; j < nCols; j += 2) {
      // if pixel bit set, use foreground color; else use the background color
      // now get the pixel color for two successive pixels
      if((PixelRow & Mask) == 0) {
        Word0 = bcolor;
      } else {
        Word0 = fcolor;
      }
      Mask = Mask >> 1;
      if ((PixelRow & Mask) == 0) {
        Word1 = bcolor;
      } else {
        Word1 = fcolor;
      }
      Mask = Mask >> 1;
      // use this information to output three data bytes
      write_spi_data((Word0 >> 4) & 0xFF);
      write_spi_data(((Word0 & 0xF) << 4) | ((Word1 >> 8) & 0xF));
      write_spi_data(Word1 & 0xFF);
    }
  }
}

void lcd_put_str(char* string, int x, int y, int size, int fcolor, int bcolor) {
  // loop until null-terminator is seen
  while (*string != 0x00) {
    // draw the character
    lcd_put_char(*string++, x, y, size, fcolor, bcolor);
    // advance the y position
    if (size == SMALL) {
      y = y + 6;
    } else if (size == MEDIUM) {
      y = y + 8;
    } else {
      y = y + 8;
    }
    // bail out if y exceeds 131
    if (y > 131) break;
  }
}

/* USER CODE END PFP */

/* USER CODE BEGIN 0 */

/* USER CODE END 0 */

int main(void)
{

  /* USER CODE BEGIN 1 */

  /* USER CODE END 1 */

  /* MCU Configuration----------------------------------------------------------*/

  /* Reset of all peripherals, Initializes the Flash interface and the Systick. */
  HAL_Init();

  /* Configure the system clock */
  SystemClock_Config();

  /* Initialize all configured peripherals */
  MX_GPIO_Init();
  MX_USART2_UART_Init();

  /* USER CODE BEGIN 2 */
	
	init_lcd();
	HAL_Delay(1000);
  lcd_clear_screen();
	HAL_Delay(1000);
	lcd_set_circle(50, 50, 10, WHITE);

	
  /* USER CODE END 2 */

  /* Infinite loop */
  /* USER CODE BEGIN WHILE */
  while (1)
  {
  /* USER CODE END WHILE */

  /* USER CODE BEGIN 3 */

  }
  /* USER CODE END 3 */

}

/** System Clock Configuration
*/
void SystemClock_Config(void)
{

  RCC_OscInitTypeDef RCC_OscInitStruct;
  RCC_ClkInitTypeDef RCC_ClkInitStruct;
  RCC_PeriphCLKInitTypeDef PeriphClkInit;

  RCC_OscInitStruct.OscillatorType = RCC_OSCILLATORTYPE_HSI;
  RCC_OscInitStruct.HSIState = RCC_HSI_ON;
  RCC_OscInitStruct.HSICalibrationValue = 16;
  RCC_OscInitStruct.PLL.PLLState = RCC_PLL_ON;
  RCC_OscInitStruct.PLL.PLLSource = RCC_PLLSOURCE_HSI;
  RCC_OscInitStruct.PLL.PLLMUL = RCC_PLL_MUL12;
  RCC_OscInitStruct.PLL.PREDIV = RCC_PREDIV_DIV2;
  HAL_RCC_OscConfig(&RCC_OscInitStruct);

  RCC_ClkInitStruct.ClockType = RCC_CLOCKTYPE_SYSCLK;
  RCC_ClkInitStruct.SYSCLKSource = RCC_SYSCLKSOURCE_PLLCLK;
  RCC_ClkInitStruct.AHBCLKDivider = RCC_SYSCLK_DIV1;
  RCC_ClkInitStruct.APB1CLKDivider = RCC_HCLK_DIV1;
  HAL_RCC_ClockConfig(&RCC_ClkInitStruct, FLASH_LATENCY_1);

  PeriphClkInit.PeriphClockSelection = RCC_PERIPHCLK_USART2;
  PeriphClkInit.Usart2ClockSelection = RCC_USART2CLKSOURCE_PCLK1;
  HAL_RCCEx_PeriphCLKConfig(&PeriphClkInit);

  HAL_SYSTICK_Config(HAL_RCC_GetHCLKFreq()/1000);

  HAL_SYSTICK_CLKSourceConfig(SYSTICK_CLKSOURCE_HCLK);

  /* SysTick_IRQn interrupt configuration */
  HAL_NVIC_SetPriority(SysTick_IRQn, 0, 0);
}

/* USART2 init function */
void MX_USART2_UART_Init(void)
{

  huart2.Instance = USART2;
  huart2.Init.BaudRate = 38400;
  huart2.Init.WordLength = UART_WORDLENGTH_8B;
  huart2.Init.StopBits = UART_STOPBITS_1;
  huart2.Init.Parity = UART_PARITY_NONE;
  huart2.Init.Mode = UART_MODE_TX_RX;
  huart2.Init.HwFlowCtl = UART_HWCONTROL_NONE;
  huart2.Init.OverSampling = UART_OVERSAMPLING_16;
  huart2.Init.OneBitSampling = UART_ONEBIT_SAMPLING_DISABLED ;
  huart2.AdvancedInit.AdvFeatureInit = UART_ADVFEATURE_NO_INIT;
  HAL_UART_Init(&huart2);

}

/** Configure pins as 
        * Analog 
        * Input 
        * Output
        * EVENT_OUT
        * EXTI
*/
void MX_GPIO_Init(void)
{

  GPIO_InitTypeDef GPIO_InitStruct;

  /* GPIO Ports Clock Enable */
  __GPIOC_CLK_ENABLE();
  __GPIOF_CLK_ENABLE();
  __GPIOA_CLK_ENABLE();
  __GPIOB_CLK_ENABLE();

  /*Configure GPIO pin : B1_Pin */
  GPIO_InitStruct.Pin = B1_Pin;
  GPIO_InitStruct.Mode = GPIO_MODE_EVT_RISING;
  GPIO_InitStruct.Pull = GPIO_NOPULL;
  HAL_GPIO_Init(B1_GPIO_Port, &GPIO_InitStruct);

  /*Configure GPIO pins : PA0 PA1 PA4 LD2_Pin */
  GPIO_InitStruct.Pin = GPIO_PIN_0|GPIO_PIN_1|GPIO_PIN_4|LD2_Pin;
  GPIO_InitStruct.Mode = GPIO_MODE_OUTPUT_PP;
  GPIO_InitStruct.Pull = GPIO_NOPULL;
  GPIO_InitStruct.Speed = GPIO_SPEED_LOW;
  HAL_GPIO_Init(GPIOA, &GPIO_InitStruct);

  /*Configure GPIO pins : PB0 PB4 */
  GPIO_InitStruct.Pin = GPIO_PIN_0|GPIO_PIN_4;
  GPIO_InitStruct.Mode = GPIO_MODE_OUTPUT_PP;
  GPIO_InitStruct.Pull = GPIO_NOPULL;
  GPIO_InitStruct.Speed = GPIO_SPEED_LOW;
  HAL_GPIO_Init(GPIOB, &GPIO_InitStruct);

}

/* USER CODE BEGIN 4 */

/* USER CODE END 4 */

#ifdef USE_FULL_ASSERT

/**
   * @brief Reports the name of the source file and the source line number
   * where the assert_param error has occurred.
   * @param file: pointer to the source file name
   * @param line: assert_param error line source number
   * @retval None
   */
void assert_failed(uint8_t* file, uint32_t line)
{
  /* USER CODE BEGIN 6 */
  /* User can add his own implementation to report the file name and line number,
    ex: printf("Wrong parameters value: file %s on line %d\r\n", file, line) */
  /* USER CODE END 6 */

}

#endif

/**
  * @}
  */ 

/**
  * @}
*/ 

/************************ (C) COPYRIGHT STMicroelectronics *****END OF FILE****/
